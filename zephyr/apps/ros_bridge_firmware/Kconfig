## zephyr/apps/ros_bridge_firmware/Kconfig
```kconfig
mainmenu "VEL sensor demo"
source "Kconfig.zephyr"
rsource "../../drivers/sensor/vel_virtual_sensor/Kconfig"
```

## zephyr/drivers/sensor/vel_virtual_sensor/Kconfig
```kconfig
config VEL_VIRTUAL_SENSOR
    bool "VirtualEmbeddedLab virtual temperature sensor"
    depends on SENSOR
    default y
    help
      Deterministic per-instance virtual sensor with no MMIO or physical bus.
```

## zephyr/dts/bindings/sensor/vnd,vel-virtual-temp.yaml
```yaml
description: Deterministic in-memory VirtualEmbeddedLab temperature sensor
compatible: "vnd,vel-virtual-temp"
include: sensor-device.yaml
properties:
  initial-millicelsius:
    type: int
    required: true
    description: Initial temperature in milli-degrees Celsius
  step-millicelsius:
    type: int
    required: true
    description: Positive change per sample within a 128-sample cycle
  instance-id:
    type: int
    required: true
  fail-after:
    type: int
    default: 0
    description: Return EIO after this many successful fetches, zero disables
  unavailable:
    type: boolean
    description: Deliberately fail initialization for a negative runtime test
```
