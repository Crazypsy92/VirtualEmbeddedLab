## CMakeLists.txt
```
cmake_minimum_required(VERSION 3.20)
get_filename_component(VEL_ROOT "${CMAKE_CURRENT_SOURCE_DIR}/../.." ABSOLUTE)
list(APPEND DTS_ROOT ${VEL_ROOT})
find_package(Zephyr REQUIRED HINTS $ENV{ZEPHYR_BASE})
project(zephyr_micro_ros_firmware C)
set(UROS_INSTALL "${VEL_ROOT}/../build/workspaces/micro_ros_stage7_ws/arm_install" CACHE PATH "Pinned ARM micro-ROS install")
target_sources(app PRIVATE src/main.c src/bounded_heap.c)
target_sources(app PRIVATE ${VEL_ROOT}/drivers/sensor/vel_virtual_sensor/vel_virtual_sensor.c)
target_include_directories(app PRIVATE ${VEL_ROOT}/common ${UROS_INSTALL}/include)
file(GLOB UROS_INCLUDE_DIRS LIST_DIRECTORIES TRUE "${UROS_INSTALL}/include/*")
foreach(dir ${UROS_INCLUDE_DIRS})
 if(IS_DIRECTORY "${dir}")
  target_include_directories(app SYSTEM PRIVATE "${dir}")
 endif()
endforeach()
file(GLOB UROS_LIBRARIES "${UROS_INSTALL}/lib/*.a")
if(NOT UROS_LIBRARIES)
 message(FATAL_ERROR "Build real ARM micro-ROS libraries first")
endif()
zephyr_link_libraries(-Wl,--start-group ${UROS_LIBRARIES} -Wl,--end-group)
target_compile_options(app PRIVATE -Wall -Wextra -Werror)

target_compile_options(app PRIVATE -include ${VEL_ROOT}/../micro_ros/arm/platform_compat.h)
```

## Kconfig
```
mainmenu "VirtualEmbeddedLab micro-ROS"
source "Kconfig.zephyr"
rsource "../../drivers/sensor/vel_virtual_sensor/Kconfig"
```

## prj.conf
```kconfig
CONFIG_NEWLIB_LIBC=y
CONFIG_NEWLIB_LIBC_NANO=n
CONFIG_POSIX_API=y
CONFIG_MAIN_STACK_SIZE=16384
CONFIG_HEAP_MEM_POOL_SIZE=131072
CONFIG_THREAD_STACK_INFO=y
CONFIG_INIT_STACKS=y
CONFIG_SYS_HEAP_RUNTIME_STATS=y
CONFIG_BUILD_OUTPUT_BIN=y
CONFIG_DEBUG_OPTIMIZATIONS=y
CONFIG_SENSOR=y
CONFIG_VEL_VIRTUAL_SENSOR=y
CONFIG_ASSERT=y
CONFIG_DEBUG_THREAD_INFO=y

CONFIG_NEWLIB_LIBC_USE_POSIX_LIMITS_H=n

CONFIG_STATIC_INIT_GNU=y

CONFIG_UART_INTERRUPT_DRIVEN=y

CONFIG_SYS_CLOCK_TICKS_PER_SEC=1000
CONFIG_REBOOT=y
```

## optimized.conf
```kconfig
CONFIG_HEAP_MEM_POOL_SIZE=4096
CONFIG_MAIN_STACK_SIZE=6144
CONFIG_NEWLIB_LIBC_CUSTOM_SBRK=y
CONFIG_DEBUG_OPTIMIZATIONS=n
CONFIG_SIZE_OPTIMIZATIONS=y
```

## src/main.c
```c
#include "transport.h"
#include <zephyr/sys/reboot.h>
#include <vel_recovery_interfaces/msg/record.h>
#include <vel_recovery_interfaces/msg/command.h>
#include <vel_recovery_interfaces/msg/status.h>
enum state {DISCONNECTED,WAITING_AGENT,CONNECTING,CONNECTED,RUNNING,RECOVERING,STOPPED};
volatile uint32_t g_state,g_boot,g_epoch,g_recoveries,g_cleanups,g_cleanup_errors;
static __noinit uint32_t boot_magic,boot_counter;
static const struct device *const sensors[]={DEVICE_DT_GET(DT_NODELABEL(sensor_a)),DEVICE_DT_GET(DT_NODELABEL(sensor_b))};
static rcl_allocator_t alloc;
static rclc_support_t support;static rcl_init_options_t options;static rcl_node_t node;static rcl_publisher_t pubs[2],status_pub;static rcl_subscription_t sub;static rclc_executor_t executor;
static bool opt_ok,support_ok,node_ok,pub_ok[2],status_ok,sub_ok,exec_ok,finish,reboot_requested;
static uint32_t seq[2],physical[2],sampled,published,period=5,limit=128,starts,rates,last_id,last_op,last_rate,last_limit;
static vel_recovery_interfaces__msg__Command incoming;
extern unsigned long __malloc_max_total_mem;
__attribute__((noinline)) void recovery_marker(void){__asm volatile("nop" ::: "memory");}
__attribute__((noinline)) void session_ready_marker(void){__asm volatile("nop" ::: "memory");}
static void state_set(enum state s){g_state=(uint32_t)s;printk("[REC] STATE boot=%u session=%u state=%u\n",g_boot,g_epoch,g_state);recovery_marker();}
static void metrics(const char *phase)
{
 size_t unused=0;if(k_thread_stack_space_get(k_current_get(),&unused))++g_errors;struct mallinfo m=mallinfo();
 printk("[REC] MEMORY phase=%s boot=%u session=%u live=%u arena_peak=%u unused=%u sampled=%u published=%u errors=%u cleanup_errors=%u\n",phase,g_boot,g_epoch,(unsigned)m.uordblks,(unsigned)__malloc_max_total_mem,(unsigned)unused,sampled,published,g_errors,g_cleanup_errors);
}
static int status(uint32_t id,uint32_t op,uint32_t result)
{
 size_t unused=0;(void)k_thread_stack_space_get(k_current_get(),&unused);struct mallinfo m=mallinfo();
 vel_recovery_interfaces__msg__Status msg={.boot_id=g_boot,.session_id=g_epoch,.request_id=id,.opcode=op,.result=result,.state=g_state,.period_ms=period,.sampled=sampled,.published=published,.start_effects=starts,.rate_effects=rates,.errors=g_errors,.heap_live=(uint32_t)m.uordblks,.stack_unused=(uint32_t)unused};
 return (int)rcl_publish(&status_pub,&msg,NULL);
}
static void command(const void *pointer)
{
 const vel_recovery_interfaces__msg__Command *p=pointer;uint32_t result=0;g_command=p->request_id;command_marker();
 if(p->boot_id!=g_boot || p->session_id!=g_epoch)result=6;
 else if(!p->request_id || (last_id && (int32_t)(p->request_id-last_id)<0))result=3;
 else if(p->request_id==last_id){result=(p->opcode==last_op && p->period_ms==last_rate && p->count_per_sensor==last_limit)?1:3;}
 else {
  if(p->opcode==1){if(p->count_per_sensor<1 || p->count_per_sensor>5000)result=2;else{limit=p->count_per_sensor;++starts;state_set(RUNNING);}}
  else if(p->opcode==2)state_set(CONNECTED);
  else if(p->opcode==3){if(p->period_ms>200)result=2;else{period=p->period_ms;++rates;}}
  else if(p->opcode==5){finish=true;state_set(STOPPED);}
  else if(p->opcode==6){reboot_requested=true;state_set(STOPPED);}
  else if(p->opcode!=4)result=4;
  if(result==0){last_id=p->request_id;last_op=p->opcode;last_rate=p->period_ms;last_limit=p->count_per_sensor;}
 }
 if(status(p->request_id,p->opcode,result)!=RCL_RET_OK){++g_errors;state_set(RECOVERING);}
}
#define TRY(expr,flag) do {if((expr)!=RCL_RET_OK){printk("[REC] CREATE_FAIL line=%d\n",__LINE__);return false;}flag=true;}while(0)
static bool create(void)
{
 ++g_epoch;seq[0]=seq[1]=0;
 options=rcl_get_zero_initialized_init_options();node=rcl_get_zero_initialized_node();pubs[0]=rcl_get_zero_initialized_publisher();pubs[1]=rcl_get_zero_initialized_publisher();status_pub=rcl_get_zero_initialized_publisher();sub=rcl_get_zero_initialized_subscription();executor=rclc_executor_get_zero_initialized_executor();memset(&support,0,sizeof support);
 alloc=rcl_get_default_allocator();TRY(rcl_init_options_init(&options,alloc),opt_ok);if(rcl_init_options_set_domain_id(&options,255))return false;
 TRY(rclc_support_init_with_options(&support,0,NULL,&options,&alloc),support_ok);TRY(rclc_node_init_default(&node,"vel_recovery_mcu","",&support),node_ok);
 const char *topics[]={"/vel/recovery/a","/vel/recovery/b"};for(unsigned i=0;i<2;++i){TRY(rclc_publisher_init_default(&pubs[i],&node,ROSIDL_GET_MSG_TYPE_SUPPORT(vel_recovery_interfaces,msg,Record),topics[i]),pub_ok[i]);}
 TRY(rclc_publisher_init_default(&status_pub,&node,ROSIDL_GET_MSG_TYPE_SUPPORT(vel_recovery_interfaces,msg,Status),"/vel/recovery/status"),status_ok);
 TRY(rclc_subscription_init_default(&sub,&node,ROSIDL_GET_MSG_TYPE_SUPPORT(vel_recovery_interfaces,msg,Command),"/vel/recovery/command"),sub_ok);
 TRY(rclc_executor_init(&executor,&support.context,1,&alloc),exec_ok);if(rclc_executor_add_subscription(&executor,&sub,&incoming,command,ON_NEW_DATA))return false;
 state_set(CONNECTED);session_ready_marker();metrics("connected");return status(0,0,0)==0;
}
static void cleanup(void)
{
 if(support_ok)(void)rmw_uros_set_context_entity_destroy_session_timeout(rcl_context_get_rmw_context(&support.context),0);
 #define FINI(flag,expr) do{if(flag){if((expr)!=RCL_RET_OK)++g_cleanup_errors;flag=false;}}while(0)
 FINI(exec_ok,rclc_executor_fini(&executor));FINI(sub_ok,rcl_subscription_fini(&sub,&node));FINI(status_ok,rcl_publisher_fini(&status_pub,&node));for(unsigned i=0;i<2;++i){FINI(pub_ok[i],rcl_publisher_fini(&pubs[i],&node));}FINI(node_ok,rcl_node_fini(&node));FINI(support_ok,rclc_support_fini(&support));FINI(opt_ok,rcl_init_options_fini(&options));
 uart_irq_rx_disable(uart);ring_buf_reset(&rx_ring);k_sem_reset(&rx_ready);
 ++g_cleanups;g_session=0;metrics("cleaned");rcl_reset_error();
}
int main(void)
{
#ifdef CONFIG_NEWLIB_LIBC_CUSTOM_SBRK
 extern int bounded_heap_check(void);
 if(bounded_heap_check())return 2;
#endif
 if(boot_magic!=0x71524941U){boot_magic=0x71524941U;boot_counter=0;}g_boot=++boot_counter;printk("[REC] BOOT id=%u\n",g_boot);
 if(!device_is_ready(sensors[0]) || !device_is_ready(sensors[1]))return 2;
 (void)rmw_uros_set_custom_transport(true,NULL,transport_open,transport_close,transport_write,transport_read);state_set(DISCONNECTED);
 const int64_t end=k_uptime_get()+900000;unsigned failures=0;uint32_t backoff=100;
 while(!finish && k_uptime_get()<end && g_epoch<8){
  state_set(WAITING_AGENT);
  if(rmw_uros_ping_agent(100,1)!=RMW_RET_OK){if(++failures>=12){break;}k_msleep(backoff);if(backoff<500)backoff*=2;continue;}
  state_set(CONNECTING);
  if(!create()){cleanup();if(g_cleanup_errors || ++failures>=12)break;k_msleep(200);continue;}
  g_session=1;failures=0;backoff=100;int64_t ping=k_uptime_get()+200,heartbeat=k_uptime_get()+200,next=k_uptime_get();
  while(!finish && !reboot_requested && g_state!=RECOVERING && k_uptime_get()<end){
   rcl_ret_t rc=rclc_executor_spin_some(&executor,RCL_MS_TO_NS(1));if(rc!=RCL_RET_OK && rc!=RCL_RET_TIMEOUT){++g_errors;printk("[REC] EXEC_ERROR rc=%d\n",(int)rc);state_set(RECOVERING);break;}
   if(k_uptime_get()>=ping){if(rmw_uros_ping_agent(200,3)!=RMW_RET_OK){printk("[REC] PING_TIMEOUT\n");state_set(RECOVERING);break;}ping=k_uptime_get()+200;}
   if(k_uptime_get()>=heartbeat){if(status(0,0,0)){printk("[REC] STATUS_ERROR\n");state_set(RECOVERING);break;}heartbeat=k_uptime_get()+200;}
   if(g_state==RUNNING && k_uptime_get()>=next){
    for(unsigned sid=0;sid<2;++sid){if(seq[sid]>=limit)continue;struct sensor_value value;if(sensor_sample_fetch(sensors[sid]) || sensor_channel_get(sensors[sid],SENSOR_CHAN_AMBIENT_TEMP,&value)){++g_errors;state_set(STOPPED);finish=true;break;}
     vel_recovery_interfaces__msg__Record msg={.boot_id=g_boot,.session_id=g_epoch,.sensor_id=sid,.sequence=seq[sid]++,.sample_index=physical[sid]++,.temperature_milli_c=value.val1*1000+value.val2/1000,.uptime_ms=(uint32_t)k_uptime_get()};++sampled;
     if(rcl_publish(&pubs[sid],&msg,NULL)){printk("[REC] PUBLISH_ERROR sid=%u\n",sid);state_set(RECOVERING);break;}++published;
    }
    next=k_uptime_get()+period;if(seq[0]>=limit && seq[1]>=limit)state_set(CONNECTED);
   }
   k_msleep(1);
  }
  if(!finish && !reboot_requested){state_set(RECOVERING);++g_recoveries;}
  cleanup();if(g_cleanup_errors)break;
  if(reboot_requested){printk("[REC] SOFTWARE_REBOOT\n");sys_reboot(SYS_REBOOT_COLD);}
  if(!finish)k_msleep(100);
 }
 state_set(STOPPED);printk("[REC] STOP boot=%u sessions=%u recoveries=%u failures=%u cleanup_errors=%u\n",g_boot,g_epoch,g_recoveries,failures,g_cleanup_errors);return g_cleanup_errors?2:0;
}
```

## src/bounded_heap.c
```c
/* Zephyr's documented NEWLIB_LIBC_CUSTOM_SBRK platform hook; no Newlib changes. */
#include <zephyr/kernel.h>
#include <stdint.h>
#include <errno.h>
#ifdef CONFIG_NEWLIB_LIBC_CUSTOM_SBRK
static uint8_t arena[8192] __aligned(8);
static struct k_spinlock arena_lock;
volatile size_t g_sbrk_used;
void *_sbrk(intptr_t count)
{
 k_spinlock_key_t key=k_spin_lock(&arena_lock);
 size_t used=g_sbrk_used;
 if ((count>=0 && (uintptr_t)count>sizeof arena-used) ||
     (count<0 && count<-(intptr_t)used)) {
  k_spin_unlock(&arena_lock,key);errno=ENOMEM;return (void *)-1;
 }
 void *result=arena+used;
 g_sbrk_used=(size_t)((intptr_t)used+count);
 k_spin_unlock(&arena_lock,key);
 return result;
}
int bounded_heap_check(void)
{
 void *before=_sbrk(0);
 if (_sbrk(8193)!=(void *)-1 || _sbrk(0)!=before)return -1;
 printk("[REC] HEAP_BOUND capacity=8192 overflow_rejected=1\n");
 return 0;
}
#endif
```

## src/transport.h
```c
#ifndef VEL_XRCE_TRANSPORT_H
#define VEL_XRCE_TRANSPORT_H
#include <zephyr/kernel.h>
#include <zephyr/drivers/uart.h>
#include <zephyr/drivers/sensor.h>
#include <malloc.h>
#include <stdio.h>
#include <zephyr/sys/ring_buffer.h>
#include <rcl/rcl.h>
#include <rclc/rclc.h>
#include <rclc/executor.h>
#include <rmw_microros/rmw_microros.h>
#include <uxr/client/profile/transport/custom/custom_transport.h>
#include <std_msgs/msg/int32.h>
static const struct device *const uart=DEVICE_DT_GET(DT_NODELABEL(uart1));
volatile uint32_t g_urx,g_utx,g_command,g_published,g_session,g_errors;
RING_BUF_DECLARE(rx_ring,2048);
K_SEM_DEFINE(rx_ready,0,1);
static void uart_interrupt(const struct device *dev,void *arg)
{
 (void)arg;while(uart_irq_update(dev) && uart_irq_rx_ready(dev)){
  uint8_t bytes[32];int count=uart_fifo_read(dev,bytes,sizeof bytes);
  if(count<=0)break;
  if(ring_buf_put(&rx_ring,bytes,(uint32_t)count)!=(uint32_t)count)++g_errors;
  g_urx+=(uint32_t)count;k_sem_give(&rx_ready);
 }
}
static bool transport_open(struct uxrCustomTransport *t){(void)t;if(!device_is_ready(uart))return false;uart_irq_callback_user_data_set(uart,uart_interrupt,NULL);uart_irq_rx_enable(uart);return true;}
static bool transport_close(struct uxrCustomTransport *t){(void)t;return true;}
__attribute__((noinline)) void xrce_rx_marker(void){__asm volatile("nop" ::: "memory");}
__attribute__((noinline)) void command_marker(void){__asm volatile("nop" ::: "memory");}
static size_t transport_write(struct uxrCustomTransport *t,const uint8_t *buf,size_t len,uint8_t *err)
{
 (void)t;*err=0;for(size_t i=0;i<len;++i)uart_poll_out(uart,buf[i]);g_utx+=(uint32_t)len;return len;
}
static size_t transport_read(struct uxrCustomTransport *t,uint8_t *buf,size_t len,int timeout,uint8_t *err)
{
 (void)t;*err=0;size_t n=ring_buf_get(&rx_ring,buf,(uint32_t)len);
 if(!n && timeout>0){(void)k_sem_take(&rx_ready,K_MSEC(timeout));n=ring_buf_get(&rx_ring,buf,(uint32_t)len);}
 if(n){xrce_rx_marker();}
 return n;
}

#endif
```
