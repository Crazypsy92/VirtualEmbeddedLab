## CMakeLists.txt
```
cmake_minimum_required(VERSION 3.20)
find_package(Zephyr REQUIRED HINTS $ENV{ZEPHYR_BASE})
project(backend_native C)
if(VEL_CAN_INSPECTOR)
  target_sources(app PRIVATE src/can_inspector.c)
else()
  target_sources(app PRIVATE src/main.c)
endif()
target_compile_options(app PRIVATE -Wall -Wextra -Werror)
```

## prj.conf
```kconfig
CONFIG_GPIO=y
CONFIG_CAN=y
CONFIG_CAN_LOOPBACK=y
CONFIG_SERIAL=y
CONFIG_UART_CONSOLE=n
CONFIG_CONSOLE=y
CONFIG_POSIX_ARCH_CONSOLE=y
CONFIG_MAIN_STACK_SIZE=4096
CONFIG_ASSERT=y
```

## app.overlay
```dts
&uart1 { status = "okay"; };
```

## src/main.c
```c
#include <zephyr/kernel.h>
#include <zephyr/drivers/gpio.h>
#include <zephyr/drivers/gpio/gpio_emul.h>
#include <zephyr/drivers/can.h>
#include <zephyr/drivers/uart.h>
#include <string.h>
#include <errno.h>
#define CHECK(x) do { if (!(x)) { printk("FAIL line=%d\n",__LINE__); return 1; } } while (0)
static unsigned edges;
static struct gpio_callback callback;
static void edge(const struct device *d,struct gpio_callback *cb,uint32_t pins)
{ (void)d;(void)cb;if(pins & 0xf00)++edges; }
CAN_MSGQ_DEFINE(rxq,8);
static int gpio_test(void)
{
 const struct device *d=DEVICE_DT_GET(DT_NODELABEL(gpio0));CHECK(device_is_ready(d));
 for(unsigned i=0;i<8;i++)CHECK(gpio_pin_configure(d,i,GPIO_OUTPUT_LOW)==0);
 for(unsigned i=8;i<12;i++) { CHECK(gpio_pin_configure(d,i,GPIO_INPUT)==0);CHECK(gpio_pin_interrupt_configure(d,i,GPIO_INT_EDGE_BOTH)==0); }
 gpio_init_callback(&callback,edge,0xf00);CHECK(gpio_add_callback(d,&callback)==0);
 unsigned expected=0;
 for(unsigned i=0;i<1000;i++) { unsigned pin=i%8;expected^=BIT(pin);CHECK(gpio_pin_toggle(d,pin)==0);gpio_port_value_t value;CHECK(gpio_emul_output_get_masked(d,255,&value)==0);CHECK(value==expected); }
 for(unsigned i=0;i<100;i++) { unsigned pin=8+i%4;unsigned value=(i/4+1)%2;CHECK(gpio_emul_input_set(d,pin,value)==0);CHECK(gpio_pin_get(d,pin)==(int)value); }
 CHECK(edges==100);CHECK(gpio_pin_configure(d,0,GPIO_OUTPUT | GPIO_OPEN_DRAIN)==-ENOTSUP);
 printk("GPIO outputs=8 inputs=4 toggles=1000 edges=%u PASS\n",edges);return 0;
}
static int can_test(void)
{
 const struct device *d=DEVICE_DT_GET(DT_NODELABEL(can_loopback0));CHECK(device_is_ready(d));CHECK(can_set_mode(d,CAN_MODE_LOOPBACK)==0);CHECK(can_start(d)==0);
 struct can_filter standard={.id=0,.mask=0,.flags=0},extended={.id=0,.mask=0,.flags=CAN_FILTER_IDE};
 int a=can_add_rx_filter_msgq(d,&rxq,&standard),b=can_add_rx_filter_msgq(d,&rxq,&extended);CHECK(a>=0 && b>=0);
 for(unsigned i=0;i<1000;i++) {
  struct can_frame tx={.id=(i%2)?0x123400+i:0x100+i%100,.dlc=8,.flags=(i%2)?CAN_FRAME_IDE:0},rx;
  for(unsigned k=0;k<8;k++)tx.data[k]=(i>>(k%4)*8)^k;
  CHECK(can_send(d,&tx,K_MSEC(100),NULL,NULL)==0);CHECK(k_msgq_get(&rxq,&rx,K_MSEC(100))==0);CHECK(rx.id==tx.id && rx.dlc==8 && rx.flags==tx.flags && memcmp(rx.data,tx.data,8)==0);
 }
 struct can_frame rx;CHECK(k_msgq_get(&rxq,&rx,K_MSEC(10))==-EAGAIN);
 struct can_frame bad={.id=1,.dlc=9};CHECK(can_send(d,&bad,K_MSEC(10),NULL,NULL)<0);
 can_remove_rx_filter(d,a);can_remove_rx_filter(d,b);CHECK(can_stop(d)==0);printk("CAN sent=1000 received=1000 exact=1000 PASS\n");return 0;
}
int main(void)
{
 if(gpio_test() || can_test())return 1;
 const struct device *u=DEVICE_DT_GET(DT_NODELABEL(uart1));CHECK(device_is_ready(u));printk("UART_READY\n");
 char line[64];size_t n=0;bool overflow=false;unsigned frames=0,timeouts=0,overflows=0;int64_t last=k_uptime_get(),end=last+120000;
 while(k_uptime_get()<end) {
  unsigned char c;
  if(uart_poll_in(u,&c)==0) {
   last=k_uptime_get();
   if(c=='\n') {
    if(overflow){overflows++;const char *s="ERR overflow\n";while(*s)uart_poll_out(u,*s++);}
    else {line[n]=0;if(strcmp(line,"QUIT")==0){printk("UART frames=%u timeouts=%u overflows=%u DONE\n",frames,timeouts,overflows);return 0;}const char *s="ACK ";while(*s)uart_poll_out(u,*s++);for(size_t i=0;i<n;i++)uart_poll_out(u,line[i]);uart_poll_out(u,'\n');frames++;}
    n=0;overflow=false;
   } else if(n<sizeof(line)-1)line[n++]=c;else overflow=true;
  } else {if((n || overflow) && k_uptime_get()-last>200){n=0;overflow=false;timeouts++;const char *s="ERR timeout\n";while(*s)uart_poll_out(u,*s++);}k_msleep(1);}
 }
 printk("FAIL UART deadline\n");return 1;
}
```

## src/can_inspector.c
```c
#include <errno.h>
#include <string.h>
#include <zephyr/drivers/can.h>
#include <zephyr/drivers/uart.h>
#include <zephyr/kernel.h>
#include <zephyr/sys/byteorder.h>

#define COMMAND_SIZE 20
#define STANDARD_ONLY 1
#define EXTENDED_ONLY 2

CAN_MSGQ_DEFINE(standard_rx, 4);
CAN_MSGQ_DEFINE(extended_rx, 4);

static const struct device *const can = DEVICE_DT_GET(DT_NODELABEL(can_loopback0));
static const struct device *const control = DEVICE_DT_GET(DT_NODELABEL(uart1));
static int standard_filter = -1, extended_filter = -1;
static unsigned int active_filter = UINT8_MAX;

static int set_filters(unsigned int choice)
{
 if (active_filter == choice) {
  return 0;
 }
 if (standard_filter >= 0) {
  can_remove_rx_filter(can, standard_filter);
  standard_filter = -1;
 }
 if (extended_filter >= 0) {
  can_remove_rx_filter(can, extended_filter);
  extended_filter = -1;
 }
 const struct can_filter standard = {.id = 0, .mask = 0, .flags = 0};
 const struct can_filter extended = {.id = 0, .mask = 0, .flags = CAN_FILTER_IDE};
 if (choice != EXTENDED_ONLY) {
  standard_filter = can_add_rx_filter_msgq(can, &standard_rx, &standard);
  if (standard_filter < 0) {
   return standard_filter;
  }
 }
 if (choice != STANDARD_ONLY) {
  extended_filter = can_add_rx_filter_msgq(can, &extended_rx, &extended);
  if (extended_filter < 0) {
   return extended_filter;
  }
 }
 active_filter = choice;
 return 0;
}

static void frame_event(uint32_t sequence, const char *event, const struct can_frame *frame,
                        unsigned int queue)
{
 static const char hex[] = "0123456789abcdef";
 char data[CAN_MAX_DLEN * 2 + 1] = "-";

 for (size_t i = 0; i < frame->dlc; ++i) {
  data[2 * i] = hex[frame->data[i] >> 4];
  data[2 * i + 1] = hex[frame->data[i] & 15];
  data[2 * i + 2] = '\0';
 }
 printk("CAN_FRAME %u %s %lld %x %x %u %s %u\n", sequence, event,
        (long long)k_uptime_get(), frame->id, frame->flags, frame->dlc, data, queue);
}

static void dispatch(const uint8_t *data)
{
 const uint32_t sequence = sys_get_be32(&data[1]);
 const unsigned int extended = data[9];
 const unsigned int filter = data[11];
 struct can_frame tx = {.id = sys_get_be32(&data[5]), .dlc = data[10],
                        .flags = extended ? CAN_FRAME_IDE : 0};
 const uint32_t max_id = extended ? CAN_EXT_ID_MASK : CAN_STD_ID_MASK;

 if (sequence == 0 || extended > 1 || tx.id > max_id || tx.dlc > CAN_MAX_DLEN ||
     filter > EXTENDED_ONLY) {
  printk("CAN_DONE %u %d %u\n", sequence, -EINVAL, active_filter);
  return;
 }
 int rc = set_filters(filter);
 if (rc != 0) {
  printk("CAN_DONE %u %d %u\n", sequence, rc, active_filter);
  return;
 }
 memcpy(tx.data, &data[12], tx.dlc);
 frame_event(sequence, "TX", &tx, 0);
 rc = can_send(can, &tx, K_MSEC(100), NULL, NULL);
 if (rc == 0) {
  struct can_frame rx;
  struct k_msgq *expected = extended ? &extended_rx : &standard_rx;
  const unsigned int expected_queue = extended ? EXTENDED_ONLY : STANDARD_ONLY;

  if (k_msgq_get(expected, &rx, K_MSEC(25)) == 0) {
   frame_event(sequence, "RX", &rx, expected_queue);
  }
  while (k_msgq_get(&standard_rx, &rx, K_NO_WAIT) == 0) {
   frame_event(sequence, "RX", &rx, STANDARD_ONLY);
  }
  while (k_msgq_get(&extended_rx, &rx, K_NO_WAIT) == 0) {
   frame_event(sequence, "RX", &rx, EXTENDED_ONLY);
  }
 }
 printk("CAN_DONE %u %d %u\n", sequence, rc, active_filter);
}

int main(void)
{
 if (!device_is_ready(can) || !device_is_ready(control) ||
     can_set_mode(can, CAN_MODE_LOOPBACK) != 0 || can_start(can) != 0 || set_filters(0) != 0) {
  printk("CAN_INIT_FAILED\n");
  return 1;
 }
 printk("CAN_READY\n");
 uint8_t command[COMMAND_SIZE];
 size_t length = 0;

 while (true) {
  unsigned char byte;
  while (uart_poll_in(control, &byte) == 0) {
   if (length != 0 || byte == 'C') {
    command[length++] = byte;
    if (length == sizeof(command)) {
     dispatch(command);
     length = 0;
    }
   }
  }
  k_msleep(1);
 }
}
```
